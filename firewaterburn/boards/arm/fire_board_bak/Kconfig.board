## firewaterburn/boards/arm/fire_board_bak/Kconfig.board
```kconfig
# Copyright (c) 2023 Nordic Semiconductor ASA
# SPDX-License-Identifier: Apache-2.0

config BOARD_FIRE_BOARD
	bool "FireWaterburn Board"
	depends on SOC_NRF52840_QIAA

config NRF7002_ON_SPI
	def_bool $(dt_compat_enabled,$(DT_COMPAT_NORDIC_NRF700X_SPI))
	depends on BOARD_FIRE_BOARD
```

## firmware/boards/arm/fire_board/Kconfig.board
```kconfig
# Copyright (c) 2023 Nordic Semiconductor ASA
# SPDX-License-Identifier: Apache-2.0


config BOARD_FIRE_BOARD
	bool "FireWaterburn Board"
	depends on SOC_NRF52840_QIAA
```

## firmware/boards/arm/fire_board/Kconfig.defconfig
```kconfig
# Copyright (c) 2023 Nordic Semiconductor ASA
# SPDX-License-Identifier: Apache-2.0

if BOARD_FIRE_BOARD

DT_COMPAT_NORDIC_NRF700X_SPI := nordic,nrf700x-spi

config BOARD
	default "fire_board"

config BT_CTLR
   default BT

config NRF7002_ON_SPI
    def_bool $(dt_compat_enabled,$(DT_COMPAT_NORDIC_NRF700X_SPI))

endif
```

## firmware/boards/arm/fire_board/fire_board_defconfig
```kconfig
# Copyright (c) 2023 Nordic Semiconductor ASA
# SPDX-License-Identifier: Apache-2.0

CONFIG_SOC_SERIES_NRF52X=y
CONFIG_SOC_NRF52840_QIAA=y
CONFIG_BOARD_FIRE_BOARD=y

# Enable MPU
CONFIG_ARM_MPU=y

# Enable hardware stack protection
CONFIG_HW_STACK_PROTECTION=y

# Enable PINCTRL
CONFIG_PINCTRL=y

# Enable GPIO
CONFIG_GPIO=y

# enable uart driver
CONFIG_SERIAL=y

# enable console
CONFIG_CONSOLE=y
CONFIG_UART_CONSOLE=y

# enable SPI
CONFIG_SPI=y
CONFIG_SPI_NRFX=y

# enable I2C
CONFIG_I2C=y

# enable PWM
CONFIG_PWM=y

# enable ADC
CONFIG_ADC=y
CONFIG_ADC_ASYNC=y

# enable display
CONFIG_DISPLAY=y
CONFIG_SSD1306=y
```

## firmware/boards/arm/fire_board_bak/Kconfig.defconfig
```kconfig
# Copyright (c) 2023 Nordic Semiconductor ASA
# SPDX-License-Identifier: Apache-2.0

if BOARD_FIRE_BOARD

config BOARD
	default "fire_board"

config BT_CTLR
   default BT

endif
```
